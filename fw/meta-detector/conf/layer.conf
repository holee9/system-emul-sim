## fw/meta-detector/conf/layer.conf
```bitbake
# Yocto Layer Configuration for meta-detector
# Layer: meta-detector
# Description: X-ray Detector Panel SoC Firmware Layer

# We have a conf and classes directory, append to BBPATH
BBPATH .= ":${LAYERDIR}"

# We have a recipes directory, add to BBFILES
BBFILES += "${LAYERDIR}/recipes-*/*/*.bb ${LAYERDIR}/recipes-*/*/*.bbappend"

BBFILE_COLLECTIONS += "detector"
BBFILE_PATTERN_detector = "^${LAYERDIR}/"
BBFILE_PRIORITY_detector = "10"

# Layer compatibility
LAYERVERSION_detector = "1"
LAYERSERIES_COMPAT_detector = "scarthgap"

# Set license variables
LICENSE_CREATE_PACKAGE = "1"

# Enable network access during do_compile for fetching dependencies if needed
CONNECTIVITY_CHECK_URIS = "https://yoctoproject.org/"

# Additional metadata
LAYERVERSION_detector = "1"
LAYERCORE_dependency_meta-detector = "core"

BB_DANGLINGAPPENDS_WARNONLY ?= "1"
```
